## Documentation/devicetree/bindings/clock/qcom,cape-gcc.yaml
```yaml
# SPDX-License-Identifier: (GPL-2.0-only OR BSD-2-Clause)
%YAML 1.2
---
$id: http://devicetree.org/schemas/clock/qcom,cape-gcc.yaml#
$schema: http://devicetree.org/meta-schemas/core.yaml#

title: Qualcomm Cape Global Clock and Reset Controller

maintainers:
  - Taniya Das <quic_tdas@quicinc.com>
  - Dmitry Baryshkov <dmitry.baryshkov@linaro.org>

description: |
  The Global Clock Controller on the Cape family of Qualcomm platforms,
  including the Ukee variant used in devices with the SM7475 SoC.

  See also: include/dt-bindings/clock/qcom,sm7475-gcc.h

properties:
  compatible:
    const: qcom,cape-gcc

  clocks:
    items:
      - description: Board XO source
      - description: Sleep clock source
      - description: PCIe 0 pipe clock source
      - description: PCIe 1 pipe clock source
      - description: PCIe 1 PHY auxiliary clock source
      - description: UFS PHY RX symbol 0 clock source
      - description: UFS PHY RX symbol 1 clock source
      - description: UFS PHY TX symbol 0 clock source
      - description: USB3 PHY wrapper pipe clock source
    minItems: 2

  clock-names:
    items:
      - const: bi_tcxo
      - const: sleep_clk
      - const: pcie_0_pipe_clk
      - const: pcie_1_pipe_clk
      - const: pcie_1_phy_aux_clk
      - const: ufs_phy_rx_symbol_0_clk
      - const: ufs_phy_rx_symbol_1_clk
      - const: ufs_phy_tx_symbol_0_clk
      - const: usb3_phy_wrapper_gcc_usb30_pipe_clk
    minItems: 2

required:
  - compatible
  - clocks
  - clock-names
  - '#power-domain-cells'

allOf:
  - $ref: qcom,gcc.yaml#

unevaluatedProperties: false

examples:
  - |
    #include <dt-bindings/clock/qcom,rpmh.h>

    clock-controller@100000 {
        compatible = "qcom,cape-gcc";
        reg = <0x00100000 0x001f4200>;
        clocks = <&rpmhcc RPMH_CXO_CLK>, <&sleep_clk>;
        clock-names = "bi_tcxo", "sleep_clk";
        #clock-cells = <1>;
        #reset-cells = <1>;
        #power-domain-cells = <1>;
    };

...
```
